/*
 * Shared configuration for both halves of the Corne split keyboard.
 * Base hardware (kscan, matrix transform, OLED, I2C, RGB) is defined
 * in corne.dtsi. This file only adds split trackpad support.
 */

/* Split input for Cirque trackpad on peripheral (right) side */
/ {
	split_inputs {
		#address-cells = <1>;
		#size-cells = <0>;

		glidepoint_split: glidepoint_split@0 {
			compatible = "zmk,input-split";
			reg = <0>;
		};
	};
};
